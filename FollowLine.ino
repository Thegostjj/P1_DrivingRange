#include <Wire.h>
#include <Zumo32U4.h>
#include <PID_v1.h>

// ------------------------------------------------------------
// This program makes the Zumo robot follow a black line.
//
// The robot uses:
// - the line sensors to detect the track
// - the gyro to keep track of its heading
// - a PID controller to steer back toward the line and keep a straight path
// - a small state machine to detect corners and turn around them
// ------------------------------------------------------------

// ============================================================
// Global robot objects
// ============================================================
Zumo32U4Motors motors;
Zumo32U4IMU imu;
Zumo32U4LineSensors lineSensors;
Zumo32U4ButtonA buttonA;

#define NUM_SENSORS 5
uint16_t lineSensorValues[NUM_SENSORS];

// ============================================================
// Constants and variables for line following
// ============================================================
// NUDGE_DEG tells the robot how much it should shift its target heading
// when the line is slightly off-center. This helps it correct smoothly.
const float NUDGE_DEG = 3.0;
int nudgeDir = 0;  // -1 = steer right, 0 = hold, +1 = steer left

// These control the base forward speed and how strongly the robot turns.
const int BASE_SPEED = 150;          // 0-400
const int TURN_SPEED = 100;
const int MAX_CORRECTION = 100;
const uint16_t LINE_THRESHOLD = 800; // If a sensor reads above this, it sees a dark line.

// If the robot drifts too far from its target heading, apply a stronger correction.
const float HEADING_LIMIT = 3.0;
const int FORCED_CORRECTION = 60;

// ----------Gyro----------
// These variables store the gyro information and the robot's current heading.
// heading is measured in degrees, and increases when the robot turns left.
const float GYRO_SCALE = 0.07;  // deg/s per raw unit at 2000 dps
float gyroOffset = 0;
float heading = 0;
uint32_t lastMicros = 0;

// PID variables.
// Setpoint = desired heading
// Input = current heading
// Output = correction value generated by the PID
// Kp, Ki, Kd are tuning values for the controller.
double Setpoint = 0, Input = 0, Output = 0;
double Kp = 15, Ki = 0.0, Kd = 1.0;
PID myPID(&Input, &Output, &Setpoint, Kp, Ki, Kd, DIRECT);

// ============================================================
// State machine for corner handling
// ============================================================
// The robot does not just drive in one continuous mode.
// It switches between states depending on what the sensors see.
enum State { DRIVING, ADVANCING, TURNING_LEFT, TURNING_RIGHT };
State state = DRIVING;
State nextTurn;
uint32_t stateStart = 0;
float turnStartHeading = 0;

// How long to move forward before starting a corner turn.
const uint16_t ADVANCE_MS = 150;  // Gives the robot time to reach the corner.
const float TURN_ANGLE = 85;      // Slightly under 90 degrees to allow for overshoot.

// ----------Gyro functions----------
// This section is all about measuring the gyro's resting value and then
// updating the robot's heading over time.

void calibrateGyro() {
  // The gyro has a small offset even when the robot is not moving.
  // We measure that offset while the robot is still.
  ledYellow(1);
  long total = 0;

  for (uint16_t i = 0; i < 1024; i++) {
    while (!imu.gyroDataReady()) {}
    imu.readGyro();
    total += imu.g.z;
  }

  // Average the measured values to find the gyro's zero-offset.
  gyroOffset = total / 1024.0;
  ledYellow(0);
}

void updateHeading() {
  // If the gyro is not ready, we cannot read new data.
  if (!imu.gyroDataReady()) return;
  imu.readGyro();

  // Calculate the time since the last heading update.
  uint32_t now = micros();
  float dt = (now - lastMicros) / 1000000.0;
  lastMicros = now;

  // Remove the offset and convert the raw gyro reading into degrees/second.
  float rate = (imu.g.z - gyroOffset) * GYRO_SCALE;

  // Integrate angular velocity to estimate the current heading.
  heading += rate * dt;
}

// ----------Driving functions----------
// This section contains the actual motion logic used to keep the robot in the
// correct position over the line and steer at corners.

void driveStraight() {
  // The robot's current heading becomes the PID input.
  Input = heading;

  // Compute the correction needed to reach Setpoint.
  if (myPID.Compute()) {
    double error = heading - Setpoint;
    double correction = Output;

    // If the robot is too far off the heading target, force a stronger correction.
    if (fabs(error) > HEADING_LIMIT) {
      if (error > 0) correction = min(correction, (double)-FORCED_CORRECTION);
      else           correction = max(correction, (double)FORCED_CORRECTION);
    }

    // The PID output adjusts the left and right wheel speeds.
    // If correction is positive, one side speeds up and the other slows down.
    int left  = constrain(BASE_SPEED - (int)correction, -400, 400);
    int right = constrain(BASE_SPEED + (int)correction, -400, 400);
    motors.setSpeeds(left, right);
  }
}

void finishTurn() {
  // Once the turn is finished, reset the PID target to the current heading
  // so the next straight-driving phase is stable.
  Setpoint = heading;
  Output = 0;  // Clear any leftover PID output before continuing.

  // Restart the PID in automatic mode after a manual reset.
  myPID.SetMode(MANUAL);
  myPID.SetMode(AUTOMATIC);

  // Return to normal driving mode.
  state = DRIVING;
}

void followLine(bool innerLeftDark, bool innerRightDark) {
  // This function decides whether the line is drifting left or right.
  // It only looks at the two middle sensors.
  int dir = 0;

  // If the left inner sensor sees the line but the right inner sensor does not,
  // then the line is slightly to the left, so steer left.
  if (!innerLeftDark && innerRightDark)      dir = -1;  // line is to the right -> steer right
  else if (!innerRightDark && innerLeftDark) dir = +1;  // line is to the left -> steer left

  // If both sensors are on the tape, the robot is centered.
  // If both are off, the robot has likely lost the line or is in a gap.

  // Update the target heading based on the line position.
  if (dir != 0) {
    Setpoint = heading + dir * NUDGE_DEG;  // Aim a little toward the line.
  } else if (nudgeDir != 0) {
    Setpoint = heading;  // If the line is centered again, hold current heading.
  }

  // Save the most recent steering direction for the next loop.
  nudgeDir = dir;

  driveStraight();
}

// ============================================================
// Setup function
// ============================================================
void setup() {
  Serial.begin(115200);
  Wire.begin();

  // Start the IMU and make sure it's connected.
  if (!imu.init()) {
    ledRed(1);
    while (true) {}
  }

  imu.enableDefault();
  imu.configureForTurnSensing();

  // Initialize the 5 line sensors.
  lineSensors.initFiveSensors();

  // Set up the PID controller.
  myPID.SetOutputLimits(-MAX_CORRECTION, MAX_CORRECTION);
  myPID.SetSampleTime(20);
  myPID.SetMode(AUTOMATIC);

  // Calibrate the gyro while the robot is still, then wait for the user button.
  calibrateGyro();
  buttonA.waitForButton();
  delay(1000);

  // Reset heading values after startup.
  heading = 0;
  lastMicros = micros();
}

// ============================================================
// Main loop
// ============================================================
void loop() {
  // Keep updating the robot's heading every cycle.
  updateHeading();

  // Read the five sensors.
  // 0 and 4 are the outer corner sensors.
  // 1 and 3 are the inner tracking sensors.
  // 2 is the center sensor.
  lineSensors.read(lineSensorValues, QTR_EMITTERS_ON);
  bool cornerLeft  = lineSensorValues[0] > LINE_THRESHOLD;
  bool innerLeft   = lineSensorValues[1] > LINE_THRESHOLD;
  bool innerRight  = lineSensorValues[3] > LINE_THRESHOLD;
  bool cornerRight = lineSensorValues[4] > LINE_THRESHOLD;

  // Debug output so we can see sensor values on the serial monitor.
  Serial.print("InnerLeft reads: ");
  Serial.println(lineSensorValues[1]);
  Serial.print("InnerRight reads: ");
  Serial.println(lineSensorValues[3]);

  switch (state) {
    case DRIVING:
      // If either outer sensor sees a black corner, this means the line is turning.
      // In that case, prepare for a turn instead of trying to keep following the line.
      if (cornerRight || cornerLeft) {
        nextTurn = cornerRight ? TURNING_RIGHT : TURNING_LEFT;
        Setpoint = heading;  // Reset correction before advancing straight to the corner.
        nudgeDir = 0;
        stateStart = millis();
        state = ADVANCING;
      } else {
        // Otherwise, keep following the line using the inner sensors.
        followLine(innerLeft, innerRight);
      }
      break;

    case ADVANCING:
      // Move forward briefly so the robot fully reaches the corner before turning.
      driveStraight();
      if (millis() - stateStart >= ADVANCE_MS) {
        turnStartHeading = heading;
        state = nextTurn;
      }
      break;

    case TURNING_RIGHT:
      // Spin to the right until enough angle has been accumulated.
      motors.setSpeeds(TURN_SPEED, -TURN_SPEED);
      if (turnStartHeading - heading >= TURN_ANGLE) finishTurn();
      break;

    case TURNING_LEFT:
      // Spin to the left until enough angle has been accumulated.
      motors.setSpeeds(-TURN_SPEED, TURN_SPEED);
      if (heading - turnStartHeading >= TURN_ANGLE) finishTurn();
      break;
  }
}
